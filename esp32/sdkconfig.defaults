## esp32/sdkconfig.defaults
```kconfig
# Rust often needs a bit of an extra main task stack size compared to C (the default is 3K)
CONFIG_ESP_MAIN_TASK_STACK_SIZE=7000

# Use this to set FreeRTOS kernel tick frequency to 1000 Hz (100 Hz by default).
# This allows to use 1 ms granuality for thread sleeps (10 ms by default).
#CONFIG_FREERTOS_HZ=1000

# Workaround for https://github.com/espressif/esp-idf/issues/7631
#CONFIG_MBEDTLS_CERTIFICATE_BUNDLE=n
#CONFIG_MBEDTLS_CERTIFICATE_BUNDLE_DEFAULT_FULL=n

# CONFIGS
#CONFIG_ESPTOOLPY_BAUD_OTHER_VAL=921600
#CONFIG_ESPTOOLPY_FLASHMODE_QIO=y
#CONFIG_LIB_BUILDER_FLASHMODE="qio"
#CONFIG_LIB_BUILDER_FLASHFREQ="80m"
#CONFIG_ESPTOOLPY_FLASHFREQ="80m"
#CONFIG_ESPTOOLPY_FLASHSIZE_4MB=y
#CONFIG_ESPTOOLPY_FLASHSIZE="4MB"
#CONFIG_ESPTOOLPY_FLASHSIZE_DETECT=y
#CONFIG_ESPTOOLPY_MONITOR_BAUD_921600B=y
```
